## boards/shields/hwm_mkii_tb/Kconfig.defconfig
```kconfig
if SHIELD_MKII_RIGHT

config ZMK_KEYBOARD_NAME
    default "HWM-MKII-TB"

config ZMK_SPLIT_ROLE_CENTRAL
    default y
endif

if SHIELD_MKII_LEFT || SHIELD_MKII_RIGHT
config ZMK_SPLIT
    default y
endif
```

## boards/shields/hwm_mkii_tb/Kconfig.shield
```kconfig
config SHIELD_MKII_LEFT
    def_bool $(shields_list_contains,hwm_mkii_tb_left)

config SHIELD_MKII_RIGHT
    def_bool $(shields_list_contains,hwm_mkii_tb_right)
```
