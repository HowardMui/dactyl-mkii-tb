#include "hwm_mkii_tb.dtsi"
#include "mouse.dtsi"

#include <zephyr/dt-bindings/input/input-event-codes.h>

// Keyboard col

&default_transform {
    col-offset = <5>;
};

&kscan0 {
    col-gpios
        = <&pro_micro 6 GPIO_ACTIVE_HIGH>
        , <&pro_micro 7 GPIO_ACTIVE_HIGH>
        , <&pro_micro 8 GPIO_ACTIVE_HIGH> 
        , <&pro_micro 9 GPIO_ACTIVE_HIGH> 
        , <&pro_micro 21 GPIO_ACTIVE_HIGH> 
        ;
};



/ {
  trackball_listener {
    compatible = "zmk,input-listener";
    device = <&trackball>;
  };
};